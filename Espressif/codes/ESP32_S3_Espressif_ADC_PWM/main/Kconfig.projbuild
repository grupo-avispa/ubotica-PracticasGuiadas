## Espressif/codes/ESP32_S3_Espressif_ADC_PWM/main/Kconfig.projbuild
```kconfig
menu "Project Configuration"
    config ADC1_CHAN_A
        int "ADC1 channel A (GPIO pin number)"
        default 1
    config ADC1_CHAN_B
        int "ADC1 channel B (GPIO pin number)"
        default 2
    config ADC_ATTEN
        int "ADC attenuation (0-3)"
        default 3
        help 
          ADC_ATTEN=3 (default value) means ADC_ATTEN_DB_12 = voltage range 0-3.9V  
    config PWM_OUTPUT
        int "PWM output (GPIO pin number)"
        default 4
        help 
          PWM_OUTPUT=4 (default value) means GPIO4 is used for LEDC (LED control) PWM output
endmenu
```

## Espressif/codes/ESP32_S3_Espressif_Blink/main/Kconfig.projbuild
```kconfig
menu "Blink Configuration"
    config BLINK_GPIO
        int "GPIO used to blink the LED"
        default 4
        help
            When using the robot's board, GPIO4 uses red LED, GPIO5 uses blue LED
endmenu
```

## Espressif/codes/ESP32_S3_Espressif_DebounceGPIO/main/Kconfig.projbuild
```kconfig
menu "Project configuration"
    config LED1
        int "LED1"
        default 4
        prompt "GPIO pin for LED1"
    config LED2
        int "LED2"
        default 5
        prompt "GPIO pin for LED2"
    config INPUT
        int "INPUT"
        default 1
        prompt "GPIO pin for INPUT"
    config DEBOUNCE_TIME
        int "DEBOUNCE_TIME"
        default 100
        prompt "Debouncing time in milliseconds"
endmenu
```

## Espressif/codes/ESP32_S3_Espressif_GPIO/main/Kconfig.projbuild
```kconfig
menu "GPIO configuration"
    config LED1
        int "LED1"
        default 4
        prompt "GPIO pin for LED1"
    config LED2
        int "LED2"
        default 5
        prompt "GPIO pin for LED2"
    config INPUT
        int "INPUT"
        default 1
        prompt "GPIO pin for INPUT"
endmenu
```

## Espressif/codes/ESP32_S3_Espressif_LIDAR/main/Kconfig.projbuild
```kconfig
menu "LIDAR Configuration"
    config LIDAR_EN
        int "GPIO output to enable/disable LIDAR"
        default 17

    config UART2_BAUD_RATE
        int "UART2 communication speed"
        range 1200 115200
        default 115200
        help
            UART2 communication speed for LIDAR.

    config UART2_RXD
        int "UART RXD pin number"
        default 18
        help
            GPIO number for UART RX pin. It's fixed, do NOT change this unless you modify the robot board!

    config TASK_STACK_SIZE
        int "UART task stack size"
        range 1024 16384
        default 2048
        help
            Defines stack size for UART. Insufficient stack size can cause crash.        

endmenu
```

## Espressif/codes/ESP32_S3_Espressif_MCPWM/main/Kconfig.projbuild
```kconfig
menu "Project Configuration"
    config LEFT_BDC_MCPWM_GPIO_A
        int "Left wheel: MCPWM signal A GPIO"
        default 6
        help
            GPIO number for MCPWM signal A

    config LEFT_BDC_MCPWM_GPIO_B
        int "Left wheel: MCPWM signal B GPIO"
        default 7
        help
            GPIO number for MCPWM signal B

    config LEFT_BDC_ENCODER_GPIO_A
        int "Left wheel: Rotary encoder signal A GPIO"
        default 16
        help
            GPIO number for rotary encoder signal A

    config LEFT_BDC_ENCODER_GPIO_B
        int "Left wheel: Rotary encoder signal B GPIO"
        default 15
        help
            GPIO number for rotary encoder signal B

    config RIGHT_BDC_MCPWM_GPIO_A
        int "Right wheel: MCPWM signal A GPIO"
        default 11
        help
            GPIO number for MCPWM signal A
    
    config RIGHT_BDC_MCPWM_GPIO_B
        int "Right wheel: MCPWM signal B GPIO"
        default 12
        help
            GPIO number for MCPWM signal B

    config RIGHT_BDC_ENCODER_GPIO_A
        int "Right wheel: Rotary encoder signal A GPIO"
        default 14
        help
            GPIO number for rotary encoder signal A

    config RIGHT_BDC_ENCODER_GPIO_B
        int "Right wheel: Rotary encoder signal B GPIO"
        default 13
        help
            GPIO number for rotary encoder signal B
endmenu
```

## Espressif/codes/ESP32_S3_Espressif_MQTT/main/Kconfig.projbuild
```kconfig
menu "WiFi configuration"
    config WIFI_SSID
        string "WiFi SSID"
        default "<WIFI_SSID>"
        help
            Name of the WiFi network to connect to

    config WIFI_PASSWORD
        string "WiFi Password"
        default "<WIFI_PASSWORD>"
        help
            Password of the WiFi network to connect to
    
    config WIFI_MAXIMUM_RETRY
        int "WiFi maximum connection retries"
        default 10
        help
            Maximum number of retries to connect to the WiFi network
endmenu

menu "MQTT configuration"
    config BROKER_URL
        string "MQTT broker URL"
        default "mqtt://waspbrain.es"
        help
            URL of the mqtt broker to connect to

    config BROKER_PORT
        int "MQTT broker port"
        range 0 16384
        default 1886
        help
            Port to connect to

    config MQTT_USERNAME
        string "Username for the MQTT server"
        default "<MQTT_USERNAME>"
        help
            Username for the MQTT server
    
    config MQTT_PASSWORD
        string "Password for the MQTT server"
        default "<MQTT_PASSWORD>"
        help
            Password for the MQTT server

    config MQTT_TOPIC
        string "MQTT topic to publish to"
        default "/topic/qos0"
        help
            name of the mqtt topic to publish to
endmenu
```

## Espressif/codes/ESP32_S3_Espressif_TimerHW/main/Kconfig.projbuild
```kconfig
menu "Project configuration"
    config PERIOD
        int "Timer period"
        default 1000
        prompt "Set the timer period in milliseconds"
endmenu
```
